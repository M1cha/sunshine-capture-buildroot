## buildroot-external-sunshinecap/Config.in
```kconfig
source "$BR2_EXTERNAL_SUNSHINECAP_PATH/package/ffmpeg-cbs/Config.in"
source "$BR2_EXTERNAL_SUNSHINECAP_PATH/package/ffmpeg-sunshine/Config.in"
source "$BR2_EXTERNAL_SUNSHINECAP_PATH/package/growpart/Config.in"
source "$BR2_EXTERNAL_SUNSHINECAP_PATH/package/librga/Config.in"
source "$BR2_EXTERNAL_SUNSHINECAP_PATH/package/rkmpp/Config.in"
source "$BR2_EXTERNAL_SUNSHINECAP_PATH/package/sunshine/Config.in"
source "$BR2_EXTERNAL_SUNSHINECAP_PATH/package/v4l-utils/Config.in"
```

## buildroot-external-sunshinecap/configs/friendlyelec_cm3588_defconfig
```kconfig
BR2_aarch64=y
BR2_cortex_a76_a55=y
BR2_PACKAGE_HOST_LINUX_HEADERS_CUSTOM_6_1=y
BR2_TOOLCHAIN_BUILDROOT_CXX=y
BR2_GLOBAL_PATCH_DIR="$(BR2_EXTERNAL_SUNSHINECAP_PATH)/board/friendlyelec/cm3588/patches"
BR2_DOWNLOAD_FORCE_CHECK_HASHES=y
BR2_INIT_SYSTEMD=y
BR2_TARGET_GENERIC_GETTY_PORT="ttyFIQ0"
BR2_SYSTEM_DHCP="end0"
BR2_ROOTFS_OVERLAY="$(BR2_EXTERNAL_SUNSHINECAP_PATH)/board/friendlyelec/cm3588/rootfs_overlay"
BR2_ROOTFS_POST_BUILD_SCRIPT="$(BR2_EXTERNAL_SUNSHINECAP_PATH)/board/friendlyelec/cm3588/post-build.sh"
BR2_ROOTFS_POST_IMAGE_SCRIPT="support/scripts/genimage.sh"
BR2_ROOTFS_POST_SCRIPT_ARGS="-c $(BR2_EXTERNAL_SUNSHINECAP_PATH)/board/friendlyelec/cm3588/genimage.cfg"
BR2_LINUX_KERNEL=y
BR2_LINUX_KERNEL_CUSTOM_GIT=y
BR2_LINUX_KERNEL_CUSTOM_REPO_URL="https://github.com/M1cha/kernel-rockchip"
# Branch: nanopi6-v6.1.y
BR2_LINUX_KERNEL_CUSTOM_REPO_VERSION="d90bb722ad9c42d388b57def82a0e2799d0dd269"
BR2_LINUX_KERNEL_DEFCONFIG="nanopi6_linux"
BR2_LINUX_KERNEL_DTS_SUPPORT=y
BR2_LINUX_KERNEL_INTREE_DTS_NAME="rockchip/rk3588-nanopi6-rev09"
BR2_LINUX_KERNEL_DTB_KEEP_DIRNAME=y
BR2_LINUX_KERNEL_INSTALL_TARGET=y
BR2_LINUX_KERNEL_NEEDS_HOST_OPENSSL=y
BR2_PACKAGE_PIPEWIRE=y
BR2_PACKAGE_WIREPLUMBER=y
BR2_PACKAGE_LINUX_FIRMWARE=y
BR2_PACKAGE_LINUX_FIRMWARE_RTL_8169=y
BR2_PACKAGE_LINUX_FIRMWARE_ARM_MALI_CSF=y
BR2_PACKAGE_ROCKCHIP_RKBIN=y
BR2_PACKAGE_ROCKCHIP_RKBIN_TPL_FILENAME="bin/rk35/rk3588_ddr_lp4_2112MHz_lp5_2400MHz_v1.18.bin"
BR2_PACKAGE_ROCKCHIP_RKBIN_BL31_FILENAME="bin/rk35/rk3588_bl31_v1.48.elf"
BR2_PACKAGE_LUA=y
BR2_PACKAGE_ALSA_LIB=y
BR2_PACKAGE_X264=y
BR2_PACKAGE_X265=y
BR2_PACKAGE_OPENSSH=y
BR2_PACKAGE_GROWPART=y
BR2_TARGET_ROOTFS_EXT2=y
BR2_TARGET_ROOTFS_EXT2_4=y
BR2_TARGET_ROOTFS_EXT2_SIZE="512M"
BR2_TARGET_ROOTFS_SQUASHFS=y
BR2_TARGET_ROOTFS_SQUASHFS4_NONE=y
BR2_TARGET_ARM_TRUSTED_FIRMWARE=y
BR2_TARGET_ARM_TRUSTED_FIRMWARE_CUSTOM_VERSION=y
BR2_TARGET_ARM_TRUSTED_FIRMWARE_CUSTOM_VERSION_VALUE="v2.12"
BR2_TARGET_ARM_TRUSTED_FIRMWARE_PLATFORM="rk3588"
BR2_TARGET_ARM_TRUSTED_FIRMWARE_IMAGES="bl31/bl31.elf"
BR2_TARGET_UBOOT=y
BR2_TARGET_UBOOT_BUILD_SYSTEM_KCONFIG=y
BR2_TARGET_UBOOT_CUSTOM_VERSION=y
BR2_TARGET_UBOOT_CUSTOM_VERSION_VALUE="2026.01"
BR2_TARGET_UBOOT_BOARD_DEFCONFIG="cm3588-nas-rk3588"
BR2_TARGET_UBOOT_CONFIG_FRAGMENT_FILES="$(BR2_EXTERNAL_SUNSHINECAP_PATH)/board/friendlyelec/cm3588/u-boot.fragment"
BR2_TARGET_UBOOT_NEEDS_PYLIBFDT=y
BR2_TARGET_UBOOT_NEEDS_PYELFTOOLS=y
BR2_TARGET_UBOOT_NEEDS_OPENSSL=y
BR2_TARGET_UBOOT_NEEDS_GNUTLS=y
BR2_TARGET_UBOOT_NEEDS_UTIL_LINUX=y
BR2_TARGET_UBOOT_NEEDS_ROCKCHIP_RKBIN=y
BR2_PACKAGE_BUSYBOX_CONFIG_FRAGMENT_FILES="$(BR2_EXTERNAL_SUNSHINECAP_PATH)/board/friendlyelec/cm3588/busybox.fragment"
BR2_PACKAGE_HOST_DOSFSTOOLS=y
BR2_PACKAGE_HOST_DTC=y
BR2_PACKAGE_HOST_GENIMAGE=y
BR2_PACKAGE_HOST_MTOOLS=y
BR2_PACKAGE_FFMPEG_SUNSHINE_GPL=y
BR2_PACKAGE_FFMPEG_SUNSHINE_VERSION3=y
# BR2_PACKAGE_FFMPEG_SUNSHINE_FFMPEG is not set
BR2_PACKAGE_FFMPEG_SUNSHINE_SWSCALE=y
BR2_PACKAGE_FFMPEG_SUNSHINE_ENCODERS="libx264 libx265 h264_rkmpp hevc_rkmpp"
BR2_PACKAGE_FFMPEG_SUNSHINE_DECODERS=""
BR2_PACKAGE_FFMPEG_SUNSHINE_MUXERS=""
BR2_PACKAGE_FFMPEG_SUNSHINE_DEMUXERS=""
BR2_PACKAGE_FFMPEG_SUNSHINE_PARSERS=""
BR2_PACKAGE_FFMPEG_SUNSHINE_PROTOCOLS=""
BR2_PACKAGE_FFMPEG_SUNSHINE_FILTERS=""
# BR2_PACKAGE_FFMPEG_SUNSHINE_INDEVS is not set
# BR2_PACKAGE_FFMPEG_SUNSHINE_OUTDEVS is not set
BR2_PACKAGE_FFMPEG_SUNSHINE_EXTRACONF="--enable-static --disable-shared --enable-avutil --enable-bsfs"
BR2_PACKAGE_FFMPEG_SUNSHINE_RKMPP=y
BR2_PACKAGE_SUNSHINE=y
BR2_PACKAGE_V4L_UTILS=y
BR2_OPTIMIZE_3=y
```

## buildroot-external-sunshinecap/package/ffmpeg-cbs/Config.in
```kconfig
config BR2_PACKAGE_FFMPEG_CBS
	bool "ffmpeg cbs"
	select BR2_PACKAGE_FFMPEG_SUNSHINE
	help
	  ffmpegs internal cbs code built as a library.
```

## buildroot-external-sunshinecap/package/ffmpeg-sunshine/Config.in
```kconfig
config BR2_PACKAGE_FFMPEG_SUNSHINE_ARCH_SUPPORTS
	bool
	default y
	# No support for ARMv7-M in the ARM assembly logic
	depends on !BR2_ARM_CPU_ARMV7M
	# m68k coldfire causes a build failure, because the check for
	# atomics (atomic_store) succeeds, which causes ffmpeg to
	# think atomic intrinsics are available, while they are
	# not. See https://patchwork.ozlabs.org/patch/756664/ and
	# https://gcc.gnu.org/bugzilla/show_bug.cgi?id=68467 for more
	# details.
	depends on !BR2_m68k_cf
	# assertion fail in binutils
	depends on !(BR2_or1k && !BR2_TOOLCHAIN_GCC_AT_LEAST_9)

menuconfig BR2_PACKAGE_FFMPEG_SUNSHINE
	bool "ffmpeg-sunshine"
	depends on BR2_PACKAGE_FFMPEG_SUNSHINE_ARCH_SUPPORTS
	depends on BR2_TOOLCHAIN_HAS_THREADS
	help
	  FFmpeg is a complete, cross-platform solution to record,
	  convert and stream audio and video.

	  https://www.ffmpeg.org

if BR2_PACKAGE_FFMPEG_SUNSHINE

config BR2_PACKAGE_FFMPEG_SUNSHINE_GPL
	bool "Enable GPL code"
	help
	  allow use of GPL code, the resulting libs and binaries will
	  be under GPL

config BR2_PACKAGE_FFMPEG_SUNSHINE_VERSION3
	bool "Enable (L)GPL to version 3 code"
	help
	  allow use of (L)GPL version 3 code, the resulting libs and binaries
	  will be under (L)GPL version 3

config BR2_PACKAGE_FFMPEG_SUNSHINE_NONFREE
	bool "Enable nonfree code"
	help
	  allow use of nonfree code, the resulting libs and binaries
	  will be unredistributable

config BR2_PACKAGE_FFMPEG_SUNSHINE_FFMPEG
	bool "Build ffmpeg (the command line application)"
	default y
	help
	  FFmpeg is a very fast video and audio converter.
	  It can also grab from a live audio/video source.

	  It is not needed if you want to link the FFmpeg libraries
	  to your application.

config BR2_PACKAGE_FFMPEG_SUNSHINE_FFPLAY
	bool "Build ffplay"
	depends on !BR2_STATIC_LIBS # sdl2
	select BR2_PACKAGE_FFMPEG_SUNSHINE_SWSCALE
	select BR2_PACKAGE_SDL2
	help
	  FFplay is a very simple and portable media player using the
	  FFmpeg libraries and the SDL library.
	  It is mostly used as a testbed for the various FFmpeg APIs.

comment "ffplay needs a toolchain w/ dynamic library"
	depends on BR2_STATIC_LIBS

config BR2_PACKAGE_FFMPEG_SUNSHINE_FFPROBE
	bool "Build ffprobe"
	help
	  FFprobe is a utility to determine the audio and video
	  characteristics of a container file.

config BR2_PACKAGE_FFMPEG_SUNSHINE_XCBGRAB
	bool "Build X11 screen grabbing"
	depends on BR2_PACKAGE_XORG7
	select BR2_PACKAGE_LIBXCB
	help
	  X11 screen grabbing using libxcb.

config BR2_PACKAGE_FFMPEG_SUNSHINE_SWSCALE
	bool "Build libswscale"
	help
	  Swscale is a library of video scaling routines.

config BR2_PACKAGE_FFMPEG_SUNSHINE_ENCODERS
	string "Enabled encoders"
	default "all"
	help
	  Space-separated list of encoders to build in FFmpeg,
	  or "all" to build all of them.

	  Run ./configure --list-encoders in the ffmpeg sources
	  directory to know the available options.

config BR2_PACKAGE_FFMPEG_SUNSHINE_DECODERS
	string "Enabled decoders"
	default "all"
	help
	  Space-separated list of decoders to build in FFmpeg,
	  or "all" to build all of them.

	  Run ./configure --list-decoders in the ffmpeg sources
	  directory to know the available options.

config BR2_PACKAGE_FFMPEG_SUNSHINE_MUXERS
	string "Enabled muxers"
	default "all"
	help
	  Space-separated list of muxers to build in FFmpeg,
	  or "all" to build all of them.

	  Run ./configure --list-muxers in the ffmpeg sources
	  directory to know the available options.

config BR2_PACKAGE_FFMPEG_SUNSHINE_DEMUXERS
	string "Enabled demuxers"
	default "all"
	help
	  Space-separated list of demuxers to build in FFmpeg,
	  or "all" to build all of them.

	  Run ./configure --list-demuxers in the ffmpeg sources
	  directory to know the available options.

config BR2_PACKAGE_FFMPEG_SUNSHINE_PARSERS
	string "Enabled parsers"
	default "all"
	help
	  Space-separated list of parsers to build in FFmpeg,
	  or "all" to build all of them.

	  Run ./configure --list-parsers in the ffmpeg sources
	  directory to know the available options.

config BR2_PACKAGE_FFMPEG_SUNSHINE_BSFS
	string "Enabled bitstreams"
	default "all"
	help
	  Space-separated list of bitstream filters to build in FFmpeg,
	  or "all" to build all of them.

	  Run ./configure --list-bsfs in the ffmpeg sources
	  directory to know the available options.

config BR2_PACKAGE_FFMPEG_SUNSHINE_PROTOCOLS
	string "Enabled protocols"
	default "all"
	help
	  Space-separated list of protocols to build in FFmpeg,
	  or "all" to build all of them.

	  Run ./configure --list-protocols in the ffmpeg sources
	  directory to know the available options.

config BR2_PACKAGE_FFMPEG_SUNSHINE_FILTERS
	string "Enabled filters"
	default "all"
	help
	  Space-separated list of filters to build in FFmpeg,
	  or "all" to build all of them.

	  Run ./configure --list-filters in the ffmpeg sources
	  directory to know the available options.

config BR2_PACKAGE_FFMPEG_SUNSHINE_INDEVS
	bool "Enable input devices"
	default y

config BR2_PACKAGE_FFMPEG_SUNSHINE_OUTDEVS
	bool "Enable output devices"
	default y

config BR2_PACKAGE_FFMPEG_SUNSHINE_EXTRACONF
	string "Additional parameters for ./configure"
	default ""
	help
	  Extra parameters that will be appended to FFmpeg's
	  ./configure commandline.

config BR2_PACKAGE_FFMPEG_SUNSHINE_RKMPP
	bool "Enable Rockchip MPP"
	depends on BR2_PACKAGE_FFMPEG_SUNSHINE_VERSION3
	select BR2_PACKAGE_RKMPP
	select BR2_PACKAGE_LIBDRM

endif

comment "ffmpeg needs a toolchain w/ threads"
	depends on !BR2_TOOLCHAIN_HAS_THREADS
```

## buildroot-external-sunshinecap/package/growpart/Config.in
```kconfig
config BR2_PACKAGE_GROWPART
	bool "growpart"
	select BR2_PACKAGE_GPTFDISK
	select BR2_PACKAGE_GPTFDISK_SGDISK
	select BR2_PACKAGE_UTIL_LINUX_PARTX
	select BR2_PACKAGE_UTIL_LINUX_BINARIES # sfdisk
	help
	  A script for growing a partition.
```

## buildroot-external-sunshinecap/package/librga/Config.in
```kconfig
config BR2_PACKAGE_LIBRGA
	bool "librga"
	depends on BR2_TOOLCHAIN_HAS_THREADS
	depends on BR2_INSTALL_LIBSTDCPP
	select BR2_PACKAGE_LIBDRM
	help
	  RGA (Raster Graphic Acceleration Unit) is an independent 2D hardware
	  accelerator that can be used to speed up point/line drawing, perform
	  image resizing, rotation, bitBlt, alpha blending and other common 2D
	  graphics operations.
```

## buildroot-external-sunshinecap/package/rkmpp/Config.in
```kconfig
config BR2_PACKAGE_RKMPP
	bool "rkmpp"
	depends on BR2_TOOLCHAIN_HAS_THREADS
	help
	  Rockchip Media Process Platform (MPP) module.
```

## buildroot-external-sunshinecap/package/sunshine/Config.in
```kconfig
config BR2_PACKAGE_SUNSHINE
	bool "sunshine"
	depends on BR2_TOOLCHAIN_HAS_THREADS
	depends on BR2_INSTALL_LIBSTDCPP
	select BR2_HOST_CMAKE_AT_LEAST_3_20
	select BR2_PACKAGE_OPENSSL
	select BR2_PACKAGE_LIBCURL
	select BR2_PACKAGE_LIBMINIUPNPC
	select BR2_PACKAGE_LIBEVDEV
	select BR2_PACKAGE_OPUS
	select BR2_PACKAGE_PULSEAUDIO
	select BR2_PACKAGE_FFMPEG_SUNSHINE
	select BR2_PACKAGE_FFMPEG_CBS
	help
	  Self-hosted game stream host for Moonlight.
```

## buildroot-external-sunshinecap/package/v4l-utils/Config.in
```kconfig
config BR2_PACKAGE_V4L_UTILS
	bool "v4l-utils"
	help
	  Userspace tools and conversion library for Video 4 Linux.
```
